## main/Kconfig
```kconfig
menu "App config"

config WIFI_STATION_SSID
    string "default wifi station ssid"
    default Test

config WIFI_STATION_PASSWORD
    string "default wifi station password"
    default 12345678

config  MQTT_APP_URI
    string "default mqtturi"
    default 'mqtt://iot.eclipse.org:1883'

choice ESP_SMARTCONFIG_TYPE
	prompt "Smartconfig Type"
	default ESP_TOUCH
	help
		Set protocol type of SmartConfig.

		Start SmartConfig method according to the selected type when user select "ESPTouch", "AirKiss",  "ESPTouch and AirKiss" or "ESPTouch V2" type.

config ESP_TOUCH
	bool "ESPTouch"
config AIRKISS
	bool "AirKiss"
config ESP_TOUCH-AIRKISS
	bool "ESPTouch and AirKiss"
config ESP_TOUCH_V2
	bool "ESPTouch-V2"
endchoice

config ESP_SMARTCONFIG_TYPE
	int
	default 0 if ESP_TOUCH
	default 1 if AIRKISS
	default 2 if ESP_TOUCH-AIRKISS
	default 3 if ESP_TOUCH_V2

endmenu
```

## main/Kconfig.projbuild
```kconfig
menu "App config"

config LWIP_TFTPD_ON_BOOT
        bool "Start TFTPD  On Boot"
	default y

config WIFI_STATION_SSID
    string "default wifi station ssid"
    default Test

config WIFI_STATION_PASSWORD
    string "default wifi station password"
    default 12345678


menu "Network Protocols"


menuconfig NETWORK_PROTOCAL_MQTT
	bool "MQTT Client"
	default y

if  NETWORK_PROTOCAL_MQTT


choice MQTT_CLIENT_STACK
    bool "Choose MQTT Stack"
    default  MQTT_CLIENT_USE_SMGS


config MQTT_CLIENT_USE_SMGS
    bool "Use SimpleMQTTGateWayStack"

config MQTT_CLIENT_USE_ONENET_DEVICE
    bool "Use OneNETDevice"


endchoice

if MQTT_CLIENT_USE_SMGS 

config BROKER_URL
        string "Broker URL"
        default "mqtt://mqtt.hyhsystem.cn"
        help
            URL of the broker to connect to

endif


if MQTT_CLIENT_USE_ONENET_DEVICE

config ONENET_BROKER_URL
        string "Broker URL"
        default "mqtt://studio-mqtt.heclouds.com:1883"
        help
            URL of the broker to connect to

endif

endif
endmenu


config WIFI_STATION_SMARTCONIG_TIMEOUT
    int "wifi station smartconfig timeout"
    default 120

choice ESP_SMARTCONFIG_TYPE
	prompt "Smartconfig Type"
	default ESP_TOUCH
	help
		Set protocol type of SmartConfig.

		Start SmartConfig method according to the selected type when user select "ESPTouch", "AirKiss",  "ESPTouch and AirKiss" or "ESPTouch V2" type.

config ESP_TOUCH
	bool "ESPTouch"
config AIRKISS
	bool "AirKiss"
config ESP_TOUCH-AIRKISS
	bool "ESPTouch and AirKiss"
config ESP_TOUCH_V2
	bool "ESPTouch-V2"
endchoice

config ESP_SMARTCONFIG_TYPE
	int
	default 0 if ESP_TOUCH
	default 1 if AIRKISS
	default 2 if ESP_TOUCH-AIRKISS
	default 3 if ESP_TOUCH_V2

endmenu
```

## sdkconfig.defaults
```kconfig
CONFIG_PARTITION_TABLE_CUSTOM=y
CONFIG_PARTITION_TABLE_CUSTOM_FILENAME="partitions.csv"
CONFIG_PARTITION_TABLE_FILENAME="partitions.csv"
CONFIG_ESPTOOLPY_FLASHSIZE_4MB=y
CONFIG_ESPTOOLPY_FLASHSIZE="4MB"
CONFIG_SPI_FLASH_SIZE=0x400000
CONFIG_LOG_BOOTLOADER_LEVEL_VERBOSE=y
CONFIG_ESPTOOLPY_MONITOR_BAUD_115200B=y
CONFIG_ESP_CONSOLE_UART_BAUDRATE=115200
CONFIG_LWIP_DHCP_MAX_NTP_SERVERS=5
CONFIG_ESP8266_WIFI_QOS_ENABLED=y
CONFIG_LWIP_LOCAL_HOSTNAME="esp8266"
```
